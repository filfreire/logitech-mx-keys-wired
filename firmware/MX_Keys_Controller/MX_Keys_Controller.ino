/* Copyright 2023 Frank Adams
   Licensed under the Apache License, Version 2.0 (the "License");
   you may not use this file except in compliance with the License.
   You may obtain a copy of the License at
       http://www.apache.org/licenses/LICENSE-2.0
   Unless required by applicable law or agreed to in writing, software
   distributed under the License is distributed on an "AS IS" BASIS,
   WITHOUT WARRANTIES OR CONDITIONS OF ANY KIND, either express or implied.
   See the License for the specific language governing permissions and
   limitations under the License.

  Modifications Copyright 2026 Filipe Freire
*/
// Logitech MX Keys laptop-style keyboard controller on a Teensy 4.1 / FPC daughterboard.
// Based on Frank Adams' Dell_1545_Keyboard_4p1 example, with the key matrix, modifier
// matrix and pin lists generated by matrixgenerator.py (option 4 = Teensy 4.1) from the
// MX_Keys.txt key/pin recording made with Matrix_Decoder_4p1.
//
// This routine uses the Teensyduino "Micro-Manager Method" to send Normal and Modifier
// keys over USB. Multi-media keys are sent with keyboard press and release functions.
// Description of Teensyduino keyboard functions is at www.pjrc.com/teensy/td_keyboard.html
//
// NOTE: the top row follows the MX Keys legends. F1-F2, F8-F12, volume-up and calculator send
// media (consumer) codes from the consumer[] matrix; F3-F5, screenshot, menu and lock send
// OS-specific shortcuts from the shortcut[] matrix. Holding Fn (or Fn-lock) sends the plain
// key from normal[] instead. KEY_F13..KEY_F15 stay on the Easy-Switch (computer 1/2/3) keys
// for binding in software, since a wired keyboard has no hosts to switch.
//
#define MODIFIERKEY_FN 0x8f   // give Fn key a HID code
#define CAPS_LED 13 // Teensy LED shows Caps-Lock
//
// Key indicator LEDs on the FPC (found with tools/LED_Probe). Common anode on FPC 26, one
// cathode per LED; an LED is lit by pulling its cathode low. FPC n = Teensy n for these pins.
#define IND_ANODE 26 // common anode for all four indicators
#define IND_COMP1 27 // computer 1 (Easy-Switch) key LED
#define IND_COMP2 28 // computer 2 key LED
#define IND_COMP3 29 // computer 3 key LED
#define IND_CAPS  30 // Caps Lock key LED
//
// Debounce (eager, per-key): a press or release is sent the instant it is first seen, then
// that key is "locked out" for DEBOUNCE_US microseconds so contact bounce during the settle
// window is ignored. The lockout is timed, not counted in scans, so it stays the same however
// fast the matrix is scanned. It never adds latency to the change itself, and never drops a
// fast or glancing tap (a deferred debounce that waits for N stable scans can swallow very
// short taps). Raise it if a worn switch chatters; lower it toward 2000 for a tighter lockout.
#define DEBOUNCE_US 4000
//
// Time a row is held low before its columns are read, so the column lines settle. It adds
// rows_max * ROW_SETTLE_US to every scan. Raise it if keys are missed or read in the wrong row.
#define ROW_SETTLE_US 3
//
// How long a Fn+media key tap is held before its release is sent. The release happens from
// loop(), so the scan keeps running meanwhile.
#define MEDIA_TAP_US 5000
//
// Anti-ghosting (see ghost_check). A key that read pressed within GHOST_HOLD_US still counts
// as down for the check, which covers contact bounce. A press that may be a ghost (two of
// the other three rectangle corners down) must stay clear for GHOST_CONFIRM_US before it is
// sent; ordinary typing never hits this and goes through at once.
#define GHOST_HOLD_US    2000
#define GHOST_CONFIRM_US 1000
#define GHOST_NO    0
#define GHOST_MAYBE 1
#define GHOST_YES   2
//
// Set to 1 to measure scan timing and print it over the USB serial channel once a second
// (read it with tools/latency_monitor.py, see README). Set to 2 to also skip the idle check and
// always do full scans, to time them without typing. Leave at 0 for normal use.
#define LATENCY_DEBUG 0
//
// OS mode (Fn+P = Windows, Fn+O = Mac). Mac mode remaps the modifiers to the MX Keys Mac
// legends: Start key -> Option, left Alt -> Cmd, right Alt -> right Cmd.
#define OS_WIN 0
#define OS_MAC 1
#define FLASH_MS 1000 // how long an indicator LED flashes to confirm a mode change
//
// Settings saved in the Teensy EEPROM. EE_MAGIC holds SETTINGS_MAGIC once settings have been
// written; anything else (a fresh Teensy) means use the defaults. Change SETTINGS_MAGIC if
// the layout below changes.
#include <EEPROM.h>
#define SETTINGS_MAGIC 0xA5
#define EE_MAGIC   0
#define EE_FN_LOCK 1
#define EE_OS_MODE 2
#define EE_BACKLIGHT 3
//
// Backlight: PWM on pin 33 drives a low-side MOSFET on the ~27V LED string (see README).
// F6/F7 step the level down/up; level 0 is off. bl_duty[] maps each level through a 2.2
// gamma curve so every step looks like the same change in brightness.
#define BACKLIGHT_PIN 33
#define BL_PWM_HZ     20000 // above audible range, no visible flicker
#define BL_LEVELS     8     // brightness steps above off
#define BL_DEFAULT    4     // level on a fresh Teensy
#define BL_RAMP_STEP  32    // duty change per BL_RAMP_US, so a step fades in ~0.1s
#define BL_RAMP_US    1000  // time between fade steps
#define BL_DOWN 1           // backlight_key[] values
#define BL_UP   2
const int bl_duty[BL_LEVELS + 1] = {0, 42, 194, 473, 891, 1456, 2175, 3053, 4095}; // 12-bit
//
// Build at 150 MHz (FQBN option speed=150, see README). That scans the whole matrix well
// inside one 125us USB poll, while the default 600 MHz just makes the chip run warm (the loop
// never sleeps). At 150 MHz the 20kHz PWM has ~7500 steps, so the 12-bit duty is kept.
#if F_CPU != 150000000
#warning "Not built at 150 MHz: add speed=150 to the FQBN (cooler than 600, faster than 24)"
#endif
//
// The Teensy core polls the media-key interface every 8 microframes (1000Hz). Patching it to
// every microframe (8000Hz, like the keyboard interface) needs tools/patch_teensy_core.py.
#if defined(KEYMEDIA_INTERVAL) && (KEYMEDIA_INTERVAL != 1)
#warning "Media keys poll at 1000Hz: run tools/patch_teensy_core.py, then compile with --clean"
#endif
//
// Consumer page usages the Teensyduino key names don't cover (sent the same way as KEY_MEDIA_*)
#define KEY_MEDIA_BRIGHTNESS_INC (0x6F | 0xE400)  // screen brightness up
#define KEY_MEDIA_BRIGHTNESS_DEC (0x70 | 0xE400)  // screen brightness down
#define KEY_MEDIA_CALCULATOR     (0x192 | 0xE400) // AL Calculator
//
// Shortcut keys: an index into shortcuts[] below (0 = none)
#define SC_TASK_VIEW  1 // F3
#define SC_START      2 // F4
#define SC_ACTION     3 // F5
#define SC_SCREENSHOT 4 // camera key
#define SC_MENU       5 // menu key
#define SC_LOCK       6 // lock key
//
const byte rows_max = 9;  // sets the number of rows in the matrix (driven/output pins)
const byte cols_max = 16; // sets the number of columns in the matrix (read/input pins)
//
// Load the normal key matrix with the Teensyduino key names described at www.pjrc.com/teensy/td_keyboard.html
// A zero indicates no normal key at that location.
//
int normal[rows_max][cols_max] = {
  {KEY_3,KEY_SCROLL_LOCK,KEY_TILDE,KEY_HOME,KEY_Q,KEY_B,KEY_X,KEY_F11,KEY_5,0,0,0,0,0,0,0},
  {KEY_F6,KEY_F5,KEY_PAGE_DOWN,KEY_PAGE_UP,KEY_6,KEY_TAB,KEY_M,KEY_9,KEY_ESC,KEY_UP,0,0,0,0,0,0},
  {KEYPAD_8,KEY_C,KEYPAD_PERIOD,KEYPAD_ASTERIX,KEY_S,KEY_DELETE,KEY_H,KEY_J,KEY_K,KEY_4,0,0,0,0,0,0},
  {KEYPAD_5,KEYPAD_4,KEYPAD_7,KEYPAD_MINUS,KEY_O,KEY_8,KEY_BACKSLASH,KEY_0,KEY_MINUS,KEY_DOWN,0,0,0,0,0,0},
  {KEY_END,KEY_NUM_LOCK,KEYPAD_PLUS,KEYPAD_SLASH,KEY_ENTER,KEY_D,KEY_L,KEY_RIGHT_BRACE,KEY_QUOTE,KEY_U,0,0,0,0,0,0},
  {KEYPAD_2,KEY_F9,KEY_NON_US_BS,0,KEY_V,KEY_Y,KEY_SLASH,KEY_INSERT,KEY_F12,KEY_LEFT,0,0,0,0,0,0},
  {KEYPAD_3,KEY_EQUAL,KEYPAD_0,KEYPAD_1,KEY_BACKSPACE,KEY_COMMA,KEY_F2,KEY_E,KEY_W,KEY_N,0,0,0,0,0,0},
  {KEYPAD_6,KEY_F4,KEYPAD_ENTER,KEY_F7,KEY_F10,KEY_T,KEY_F1,KEY_1,KEY_2,KEY_RIGHT,0,KEY_F15,KEY_F14,KEY_F13,0,KEY_PRINTSCREEN},
  {KEYPAD_9,KEY_F8,KEY_A,KEY_F,KEY_LEFT_BRACE,KEY_CAPS_LOCK,KEY_R,KEY_PERIOD,KEY_SEMICOLON,KEY_7,KEY_I,KEY_Z,KEY_SPACE,KEY_F3,KEY_P,KEY_G}
};
// Load the modifier key matrix with key names at the correct row-column location.
// A zero indicates no modifier key at that location.
int modifier[rows_max][cols_max] = {
  {0,0,0,0,0,0,0,0,0,0,0,0,0,0,0,MODIFIERKEY_LEFT_SHIFT},
  {0,0,0,0,0,0,0,0,0,0,0,0,0,0,0,MODIFIERKEY_RIGHT_SHIFT},
  {0,0,0,0,0,0,0,0,0,0,0,0,0,0,MODIFIERKEY_LEFT_ALT,0},
  {0,0,0,0,0,0,0,0,0,0,0,0,0,0,MODIFIERKEY_RIGHT_ALT,0},
  {0,0,0,0,0,0,0,0,0,0,0,0,0,MODIFIERKEY_LEFT_CTRL,0,0},
  {0,0,0,0,0,0,0,0,0,0,0,0,MODIFIERKEY_RIGHT_CTRL,0,0,0},
  {0,0,0,0,0,0,0,0,0,0,0,MODIFIERKEY_GUI,0,0,0,0},
  {0,0,0,0,0,0,0,0,0,0,MODIFIERKEY_FN,0,0,0,0,0},
  {0,0,0,0,0,0,0,0,0,0,0,0,0,0,0,0}
};
// Load the media key matrix with Fn key names at the correct row-column location.
// A zero indicates no media key at that location. (Empty - no Fn-layer keys were recorded.)
int media[rows_max][cols_max] = {
  {0,0,0,0,0,0,0,0,0,0,0,0,0,0,0,0},
  {0,0,0,0,0,0,0,0,0,0,0,0,0,0,0,0},
  {0,0,0,0,0,0,0,0,0,0,0,0,0,0,0,0},
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  {0,0,0,0,0,0,0,0,0,0,0,0,0,0,0,0}
};
// Load the consumer key matrix with media key names (KEY_MEDIA_...) that a key sends by
// default. Holding Fn sends the normal[] key at that location instead, if there is one.
// A zero indicates no consumer key at that location.
int consumer[rows_max][cols_max] = {
  {0,0,0,0,0,0,0,KEY_MEDIA_MUTE,0,0,0,0,0,0,0,0},                        // F11 key
  {0,0,0,0,0,0,0,0,0,0,0,0,0,0,0,0},
  {0,0,0,0,0,0,0,0,0,0,0,0,0,0,0,0},
  {0,0,0,0,0,0,0,0,0,0,0,0,0,0,0,0},
  {0,0,0,0,0,0,0,0,0,0,0,0,KEY_MEDIA_VOLUME_INC,0,0,0},                  // volume-up key
  {0,KEY_MEDIA_PLAY_PAUSE,0,0,0,0,0,0,KEY_MEDIA_VOLUME_DEC,0,0,0,0,KEY_MEDIA_CALCULATOR,0,0}, // F9, F12, calculator
  {0,0,0,0,0,0,KEY_MEDIA_BRIGHTNESS_INC,0,0,0,0,0,0,0,0,0},              // F2 key
  {0,0,0,0,KEY_MEDIA_NEXT_TRACK,0,KEY_MEDIA_BRIGHTNESS_DEC,0,0,0,0,0,0,0,0,0}, // F10, F1 keys
  {0,KEY_MEDIA_PREV_TRACK,0,0,0,0,0,0,0,0,0,0,0,0,0,0}                   // F8 key
};
// Load the shortcut matrix with SC_... indices for keys that send a key combination by
// default. Holding Fn sends the normal[] key at that location instead, if there is one.
// A zero indicates no shortcut at that location.
byte shortcut[rows_max][cols_max] = {
  {0,SC_MENU,0,0,0,0,0,0,0,0,0,0,0,0,0,0},                               // menu key
  {0,SC_ACTION,0,0,0,0,0,0,0,0,0,0,0,0,0,0},                             // F5 key
  {0,0,0,0,0,0,0,0,0,0,0,0,0,0,0,0},
  {0,0,0,0,0,0,0,0,0,0,0,0,0,0,0,0},
  {0,0,0,0,0,0,0,0,0,0,0,0,0,0,0,0},
  {0,0,0,0,0,0,0,0,0,0,0,0,0,0,0,0},
  {0,0,0,0,0,0,0,0,0,0,0,0,0,0,0,0},
  {0,SC_START,0,0,0,0,0,0,0,0,0,0,0,0,SC_LOCK,SC_SCREENSHOT},            // F4, lock, camera
  {0,0,0,0,0,0,0,0,0,0,0,0,0,SC_TASK_VIEW,0,0}                           // F3 key
};
// Load the backlight key matrix with BL_DOWN / BL_UP. Holding Fn sends the normal[] key at
// that location instead. A zero indicates no backlight key at that location.
byte backlight_key[rows_max][cols_max] = {
  {0,0,0,0,0,0,0,0,0,0,0,0,0,0,0,0},
  {BL_DOWN,0,0,0,0,0,0,0,0,0,0,0,0,0,0,0},                               // F6 key
  {0,0,0,0,0,0,0,0,0,0,0,0,0,0,0,0},
  {0,0,0,0,0,0,0,0,0,0,0,0,0,0,0,0},
  {0,0,0,0,0,0,0,0,0,0,0,0,0,0,0,0},
  {0,0,0,0,0,0,0,0,0,0,0,0,0,0,0,0},
  {0,0,0,0,0,0,0,0,0,0,0,0,0,0,0,0},
  {0,0,0,BL_UP,0,0,0,0,0,0,0,0,0,0,0,0},                                 // F7 key
  {0,0,0,0,0,0,0,0,0,0,0,0,0,0,0,0}
};
// The combination each shortcut sends, per OS mode: modifiers plus one key (0 = modifiers only).
struct shortcut_def {
  int win_mod, win_key;
  int mac_mod, mac_key;
};
const shortcut_def shortcuts[] = {
  {0, 0, 0, 0},                                                    // 0: none
  {MODIFIERKEY_GUI, KEY_TAB, MODIFIERKEY_LEFT_CTRL, KEY_UP},       // task view / Mission Control
  {MODIFIERKEY_GUI, 0, 0, KEY_F4},                                 // Start menu / F4 (bind Launchpad to it)
  {MODIFIERKEY_GUI, KEY_A, 0, KEY_F5},                             // action centre / F5
  {MODIFIERKEY_GUI | MODIFIERKEY_LEFT_SHIFT, KEY_S,
   MODIFIERKEY_GUI | MODIFIERKEY_LEFT_SHIFT, KEY_4},               // snip / area screenshot
  {0, KEY_MENU, 0, KEY_MENU},                                      // menu (context) key
  {MODIFIERKEY_GUI, KEY_L, MODIFIERKEY_LEFT_CTRL | MODIFIERKEY_GUI, KEY_Q} // lock screen
};
// Key state is kept as one 16-bit mask per row: bit y is the key in column y, 1 = pressed.
// A scan then only does per-key work for the few keys that changed or are still inside a
// timed window (lockout, ghost hold), instead of visiting all rows_max * cols_max cells.
// All of these are global, so zero (nothing pressed) at reset.
//
// Committed state: what the host has been told.
uint16_t old_down[rows_max];
//
// Per-key lockout. After a key's state change is accepted, its locked bit is set and
// lock_start records micros(); the key is ignored until DEBOUNCE_US has passed, which absorbs
// contact bounce without dropping the change itself.
uint16_t locked[rows_max];
uint32_t lock_start[rows_max][cols_max];
uint32_t scan_now; // micros() at the start of the current scan
const uint32_t settle_cycles = ROW_SETTLE_US * (F_CPU / 1000000); // ROW_SETTLE_US in CPU cycles
boolean matrix_idle = false; // last scan found nothing down, sent or timing: probe all rows at once
//
// Raw state of every key from the current scan. The whole matrix is read before any change
// is acted on, so a new press can be checked for ghosting (see ghost_check).
uint16_t raw_down[rows_max];
uint16_t ghost_mask[rows_max];         // read pressed now or within GHOST_HOLD_US
uint32_t last_low[rows_max][cols_max]; // scan_now when the key last read pressed
uint16_t pending[rows_max];            // press waiting out GHOST_CONFIRM_US
uint32_t pending_start[rows_max][cols_max]; // scan_now when that wait started
//
// What each key sent when it was pressed (0 = nothing held). The release undoes exactly
// that, so changing Fn while a key is held can't leave a key stuck down on the host.
int sent[rows_max][cols_max];
boolean sent_sc[rows_max][cols_max]; // true while a key holds a shortcut's modifiers down
//
#if LATENCY_DEBUG
// Timing in CPU cycles (ARM_DWT_CYCCNT), reset after each report. scan = the matrix scan
// only (an all-rows probe when idle, else a full scan); full = the full scans among them;
// loop = from one scan start to the next, the longest a key change can wait to be seen.
uint32_t dbg_loop_start;    // cycle count at the start of the current loop
uint32_t dbg_scan_max, dbg_loop_max, dbg_scans, dbg_loops, dbg_full, dbg_full_max;
uint64_t dbg_scan_sum, dbg_loop_sum, dbg_full_sum;
uint32_t dbg_report_at;     // millis() of the last report
#endif
//
// Define the Teensy 4.1 I/O numbers (translated from the FPC pin #)
//
// Rows are the driven (output) pins - FPC 17..25
int Row_IO[rows_max] = {15,8,14,9,10,11,12,24,25};
//
// Columns are the read (input) pins with pullups - FPC 1..16
int Col_IO[cols_max] = {23,0,22,1,21,2,20,3,19,4,18,5,17,6,16,7};
//
// Direct GPIO access for the scan, filled in by setup() from the pin lists above. A row is
// driven by writing its bit to the port's clear (low) or set (released) register, and all
// columns are read with one load per GPIO port, instead of a pinMode/digitalRead per pin.
volatile uint32_t *row_clr[rows_max]; // write row_mask here to drive the row low
volatile uint32_t *row_set[rows_max]; // write row_mask here to release it (open drain = hi-z)
uint32_t row_mask[rows_max];
const byte ports_max = 4;               // the columns span GPIO6, GPIO7 and GPIO9
volatile uint32_t *port_psr[ports_max]; // pad status register of each port the columns use
byte port_count = 0;
byte col_port[cols_max];                // which port_psr[] each column is on
uint32_t col_mask[cols_max];            // and its bit in that port
uint32_t port_cols[ports_max];          // all column bits on each port


// Declare variables that will be used by functions
boolean slots_full = LOW; // Goes high when slots 1 thru 6 contain normal keys
// slot 1 thru slot 6 hold the normal key values to be sent over USB.
int slot1 = 0; //value of 0 means the slot is empty and can be used.
int slot2 = 0;
int slot3 = 0;
int slot4 = 0;
int slot5 = 0;
int slot6 = 0;
//
int mod_shift_l = 0; // These variables are sent over USB as modifier keys.
int mod_shift_r = 0; // Each is either set to 0 or MODIFIER_ ...
int mod_ctrl_l = 0;
int mod_ctrl_r = 0;
int mod_alt_l = 0;
int mod_alt_r = 0;
int mod_gui = 0;
int mod_gui_r = 0; // right GUI (right Cmd in Mac mode)
int mod_shortcut = 0; // modifiers held by a shortcut key (see shortcuts[])
//
boolean Fn_pressed = HIGH; // Initialize Fn key to HIGH = "not pressed"
boolean fn_lock = false;   // toggled by Fn+Esc. Off: consumer keys send media by default.
                           // On: they send their normal F-key by default. Fn flips either.
byte os_mode = OS_WIN;     // set by Fn+P (Windows) / Fn+O (Mac)
byte bl_level = BL_DEFAULT; // backlight level, 0 (off) .. BL_LEVELS
int bl_now = 0;            // backlight PWM duty currently output, ramps toward bl_duty[bl_level]
uint32_t bl_ramp_at;       // micros() of the last fade step
int flash_pin = 0;         // indicator LED currently flashing (0 = none)
unsigned long flash_start; // millis() when that flash started
int media_tap = 0;         // Fn+media key whose release is pending (0 = none)
uint32_t media_tap_start;  // micros() when that tap was pressed
//
// Function to load the key name into the first available slot
void load_slot(int key) {
  if (!slot1)  {
    slot1 = key;
  }
  else if (!slot2) {
    slot2 = key;
  }
  else if (!slot3) {
    slot3 = key;
  }
  else if (!slot4) {
    slot4 = key;
  }
  else if (!slot5) {
    slot5 = key;
  }
  else if (!slot6) {
    slot6 = key;
  }
  if (!slot1 || !slot2 || !slot3 || !slot4 || !slot5 || !slot6)  {
    slots_full = LOW; // slots are not full
  }
  else {
    slots_full = HIGH; // slots are full
  }
}
//
// Function to clear the slot that contains the key name
void clear_slot(int key) {
  if (slot1 == key) {
    slot1 = 0;
  }
  else if (slot2 == key) {
    slot2 = 0;
  }
  else if (slot3 == key) {
    slot3 = 0;
  }
  else if (slot4 == key) {
    slot4 = 0;
  }
  else if (slot5 == key) {
    slot5 = 0;
  }
  else if (slot6 == key) {
    slot6 = 0;
  }
  if (!slot1 || !slot2 || !slot3 || !slot4 || !slot5 || !slot6)  {
    slots_full = LOW; // slots are not full
  }
  else {
    slots_full = HIGH; // slots are full
  }
}
//
// Function to load the modifier key name into the appropriate mod variable
void load_mod(int m_key) {
  if (m_key == MODIFIERKEY_LEFT_SHIFT)  {
    mod_shift_l = m_key;
  }
  else if (m_key == MODIFIERKEY_RIGHT_SHIFT)  {
    mod_shift_r = m_key;
  }
  else if (m_key == MODIFIERKEY_LEFT_CTRL)  {
    mod_ctrl_l = m_key;
  }
  else if (m_key == MODIFIERKEY_RIGHT_CTRL)  {
    mod_ctrl_r = m_key;
  }
  else if (m_key == MODIFIERKEY_LEFT_ALT)  {
    mod_alt_l = m_key;
  }
  else if (m_key == MODIFIERKEY_RIGHT_ALT)  {
    mod_alt_r = m_key;
  }
  else if (m_key == MODIFIERKEY_GUI)  {
    mod_gui = m_key;
  }
  else if (m_key == MODIFIERKEY_RIGHT_GUI)  {
    mod_gui_r = m_key;
  }
}
//
// Function to load 0 into the appropriate mod variable
void clear_mod(int m_key) {
  if (m_key == MODIFIERKEY_LEFT_SHIFT)  {
    mod_shift_l = 0;
  }
  else if (m_key == MODIFIERKEY_RIGHT_SHIFT)  {
    mod_shift_r = 0;
  }
  else if (m_key == MODIFIERKEY_LEFT_CTRL)  {
    mod_ctrl_l = 0;
  }
  else if (m_key == MODIFIERKEY_RIGHT_CTRL)  {
    mod_ctrl_r = 0;
  }
  else if (m_key == MODIFIERKEY_LEFT_ALT)  {
    mod_alt_l = 0;
  }
  else if (m_key == MODIFIERKEY_RIGHT_ALT)  {
    mod_alt_r = 0;
  }
  else if (m_key == MODIFIERKEY_GUI)  {
    mod_gui = 0;
  }
  else if (m_key == MODIFIERKEY_RIGHT_GUI)  {
    mod_gui_r = 0;
  }
}
//
// Function to translate a modifier for the current OS mode
int os_mod(int m_key) {
  if (os_mode == OS_MAC) {
    if (m_key == MODIFIERKEY_GUI)       return MODIFIERKEY_LEFT_ALT;  // Start key -> Option
    if (m_key == MODIFIERKEY_LEFT_ALT)  return MODIFIERKEY_GUI;       // Alt -> Cmd
    if (m_key == MODIFIERKEY_RIGHT_ALT) return MODIFIERKEY_RIGHT_GUI; // Alt Gr -> right Cmd
  }
  return m_key;
}
//
// Reports are batched: set_mod() and set_normals() only update the report, and scan_matrix()
// sends it once per row. Every report sent waits for its own 125us USB poll, so sending one
// per change would make the second of two keys changing in the same row arrive a poll late.
// (Changes in two different rows of the same scan still go out as two reports: sending each
// row at once is what gets a change out without waiting for the rest of the scan.)
boolean report_dirty = false; // the report changed since it was last sent
//
// Function to load the modifier keys into the USB report
void set_mod() {
  Keyboard.set_modifier(mod_shift_l | mod_shift_r | mod_ctrl_l | mod_ctrl_r | mod_alt_l | mod_alt_r | mod_gui | mod_gui_r | mod_shortcut);
  report_dirty = true;
}
//
// Function to load the normal keys in the 6 slots into the USB report
void set_normals() {
  Keyboard.set_key1(slot1);
  Keyboard.set_key2(slot2);
  Keyboard.set_key3(slot3);
  Keyboard.set_key4(slot4);
  Keyboard.set_key5(slot5);
  Keyboard.set_key6(slot6);
  report_dirty = true;
}
//
// Function to send the USB report if it changed
void flush_report() {
  if (report_dirty) {
    Keyboard.send_now();
    report_dirty = false;
  }
}
//
// Function to press a shortcut for the current OS mode: modifiers first, then the key, as
// two reports so the host sees the modifiers already down. Returns the key it loaded into a
// slot (0 if modifiers only) so the release can clear exactly that.
int press_shortcut(byte sc) {
  int m_key = (os_mode == OS_MAC) ? shortcuts[sc].mac_mod : shortcuts[sc].win_mod;
  int key = (os_mode == OS_MAC) ? shortcuts[sc].mac_key : shortcuts[sc].win_key;
  mod_shortcut = m_key;
  set_mod();
  if (key) {
    flush_report(); // the modifiers go out in their own report first
    load_slot(key);
    set_normals();
  }
  return key;
}
//
// Function to release a shortcut: the key first, then the modifiers
void release_shortcut(int key) {
  if (key) {
    clear_slot(key);
    set_normals();
    flush_report(); // the key release goes out in its own report first
  }
  mod_shortcut = 0;
  set_mod();
}
//
// Function to check a new press for ghosting. The matrix has no diodes, so when three keys
// at the corners of a rectangle (two in one row, two in one column) are down, current flows
// through them and the fourth corner reads pressed too (e.g. J+K+; also shows "."). The
// matrix can't tell which corner is real, so a press that closes such a rectangle is held
// back; it is retried every scan and goes through once the rectangle breaks.
// Returns GHOST_YES for a full rectangle, GHOST_MAYBE when two of the other three corners
// are down (the third may just be bouncing, or sampled open: rows are read ~30us apart),
// GHOST_NO otherwise. A key counts as down if it is in ghost_mask (read pressed in this scan,
// or within GHOST_HOLD_US: a bouncing contact can read open at the moment its row is sampled).
// Each other row r is checked against every other column at once, as bit masks.
byte ghost_check(int x, int y)
{
  byte result = GHOST_NO;
  uint16_t others = ~(1 << y);                 // every column but this key's own
  uint16_t row_mates = ghost_mask[x] & others; // keys down in this key's row
  for (int r = 0; r < rows_max; r++) {
    if (r == x) continue;
    uint16_t opposite = ghost_mask[r] & others;               // row r, the other columns
    uint16_t col_mate = (ghost_mask[r] >> y) & 1 ? others : 0; // row r, this key's column
    if (row_mates & opposite & col_mate) return GHOST_YES;    // all three corners down
    if ((row_mates & opposite) | (row_mates & col_mate) | (opposite & col_mate)) {
      result = GHOST_MAYBE;                                    // two of the three down
    }
  }
  return result;
}
//
// Function to decide whether a new press may be sent. A GHOST_MAYBE press must stay clear
// of a full rectangle for GHOST_CONFIRM_US first; a clean press goes through at once.
boolean press_ok(int x, int y)
{
  uint16_t bit = 1 << y;
  byte g = ghost_check(x, y);
  if (g == GHOST_YES) {
    pending[x] &= ~bit;
    return false;
  }
  if (g == GHOST_MAYBE) {
    if (!(pending[x] & bit)) {
      pending[x] |= bit;
      pending_start[x][y] = scan_now;
    }
    if (scan_now - pending_start[x][y] < GHOST_CONFIRM_US) return false;
  }
  pending[x] &= ~bit;
  return true;
}
//
// Function to commit a key's new state and start its debounce lockout
void commit_key(int x, int y, boolean pressed)
{
  uint16_t bit = 1 << y;
  if (pressed) {
    old_down[x] |= bit;
  }
  else {
    old_down[x] &= ~bit;
  }
  locked[x] |= bit;
  lock_start[x][y] = scan_now;
}
//
// Function to set a row pin as an open-drain output, released (hi-z) to start. The weak
// pullup matches the old pinMode(INPUT) + digitalWrite(HIGH) idle state of a row. Driving
// the row is then a single write to its port's clear or set register (see row_clr/row_set).
void row_pin(int x)
{
  int pin = Row_IO[x];
  row_clr[x] = portClearRegister(pin);
  row_set[x] = portSetRegister(pin);
  row_mask[x] = digitalPinToBitMask(pin);
  *row_set[x] = row_mask[x]; // output latch high = released, before the pin becomes an output
  pinMode(pin, OUTPUT_OPENDRAIN);
  *portControlRegister(pin) = IOMUXC_PAD_DSE(7) | IOMUXC_PAD_ODE |
                              IOMUXC_PAD_PKE | IOMUXC_PAD_PUE | IOMUXC_PAD_PUS(3) | IOMUXC_PAD_HYS;
}
//
// Function to set a column pin as an input with a pullup, and find its port and bit for the scan
void col_pin(int y)
{
  int pin = Col_IO[y];
  pinMode(pin, INPUT_PULLUP);
  volatile uint32_t *psr = portInputRegister(pin);
  byte p = 0;
  while ((p < port_count) && (port_psr[p] != psr)) {
    p++;
  }
  if (p == port_count) {       // first column on this port
    port_psr[port_count++] = psr;
  }
  col_port[y] = p;
  col_mask[y] = digitalPinToBitMask(pin);
  port_cols[p] |= col_mask[y];
}
//
// Function to make an indicator LED pin a weak output. There are no series resistors on the
// indicator LEDs, so the pad drive strength is dropped to DSE=1 (~150 ohm output impedance)
// on both the anode and cathode pins, which limits each LED to a few mA.
void ind_pin(int pin, int level)
{
  pinMode(pin, OUTPUT);
  *portControlRegister(pin) = IOMUXC_PAD_DSE(1);
  digitalWrite(pin, level);
}
//
// Function to turn an indicator LED on or off (cathode low = on, high = off)
void set_ind(int pin, boolean on)
{
  digitalWrite(pin, on ? LOW : HIGH);
}
//
// Function to light an indicator LED briefly; loop() turns it off after FLASH_MS
void flash_ind(int pin)
{
  if (flash_pin) {
    set_ind(flash_pin, false); // cut short any flash already running
  }
  flash_pin = pin;
  flash_start = millis();
  set_ind(pin, true);
}
//
// Function to load the saved settings, or keep the defaults on a fresh Teensy
void load_settings()
{
  if (EEPROM.read(EE_MAGIC) == SETTINGS_MAGIC) {
    fn_lock = EEPROM.read(EE_FN_LOCK) != 0;
    os_mode = (EEPROM.read(EE_OS_MODE) == OS_MAC) ? OS_MAC : OS_WIN;
    byte level = EEPROM.read(EE_BACKLIGHT); // unwritten (0xFF) on boards saved before this
    bl_level = (level <= BL_LEVELS) ? level : BL_DEFAULT;
  }
}
//
// Function to save the settings. EEPROM.update only writes bytes that changed, and this is
// only called when a setting changes, so flash wear is not a concern.
void save_settings()
{
  EEPROM.update(EE_FN_LOCK, fn_lock);
  EEPROM.update(EE_OS_MODE, os_mode);
  EEPROM.update(EE_BACKLIGHT, bl_level);
  EEPROM.update(EE_MAGIC, SETTINGS_MAGIC);
}
//
// Function to step the backlight level up or down and save it. loop() fades to the new level.
void step_backlight(byte dir)
{
  if ((dir == BL_UP) && (bl_level < BL_LEVELS)) {
    bl_level++;
  }
  else if ((dir == BL_DOWN) && (bl_level > 0)) {
    bl_level--;
  }
  save_settings();
}
//
// Function to switch OS mode, confirm it on an indicator LED (computer 1 = Windows,
// computer 2 = Mac) and save it
void set_os_mode(byte mode)
{
  os_mode = mode;
  flash_ind(mode == OS_MAC ? IND_COMP2 : IND_COMP1);
  save_settings();
}
//
//----------------------------------Setup-------------------------------------------
void setup() {
  load_settings();
//
  analogWriteResolution(12);                     // 0..4095, matches bl_duty[]
  analogWriteFrequency(BACKLIGHT_PIN, BL_PWM_HZ);
  analogWrite(BACKLIGHT_PIN, 0);                 // start dark; loop() fades up to bl_level
//
  ind_pin(IND_ANODE, HIGH); // power the common anode
  ind_pin(IND_COMP1, HIGH); // all indicators start off
  ind_pin(IND_COMP2, HIGH);
  ind_pin(IND_COMP3, HIGH);
  ind_pin(IND_CAPS, HIGH);
//
  pinMode(CAPS_LED, OUTPUT);
//
  for (int a = 0; a < cols_max; a++) {  // loop thru all column pins
    col_pin(a); // set each column pin as an input with a pullup
  }
//
  for (int b = 0; b < rows_max; b++) {  // loop thru all row pins
    row_pin(b); // set each row pin as a released open-drain output
  }
}
//
// Function to sample the columns of the row(s) currently driven low: one read per port, so
// all columns are sampled together. Turning that into a column mask (cols_down) is slower, so
// it is kept separate and done after the next row has been driven.
void read_ports(uint32_t *port_val)
{
  for (int p = 0; p < port_count; p++) {
    port_val[p] = *port_psr[p]; // every column on this port, read at once
  }
}
//
// Function to turn a port sample into a mask with bit y set for each column that reads low
// (key pressed, negative logic)
uint16_t cols_down(const uint32_t *port_val)
{
  uint16_t down = 0;
  for (int y = 0; y < cols_max; y++) {   // loop thru the columns
    if (!(port_val[col_port[y]] & col_mask[y])) {
      down |= 1 << y;
    }
  }
  return down;
}
//
// Function to wait until ROW_SETTLE_US has passed since a row was driven low (start = the
// ARM_DWT_CYCCNT cycle count then). Work done since then counts toward the wait.
void settle_wait(uint32_t start)
{
  while (ARM_DWT_CYCCNT - start < settle_cycles) {
  }
}
//
// Function to store a row's new reading and update its ghost-check state
void decode_row(int x, uint16_t down)
{
  raw_down[x] = down;
  pending[x] &= down; // a press waiting on the ghost check went away
  for (uint16_t m = down; m; m &= m - 1) { // keys held: restart their ghost hold window
    last_low[x][__builtin_ctz(m)] = scan_now;
  }
  for (uint16_t m = ghost_mask[x] & ~down; m; m &= m - 1) { // keys let go: end it once over
    int y = __builtin_ctz(m);
    if (scan_now - last_low[x][y] >= GHOST_HOLD_US) {
      ghost_mask[x] &= ~(1 << y);
    }
  }
  ghost_mask[x] |= down;
}
//
// Function to act on each key's change in a row. Rows after x still hold the previous
// scan's state for the ghost check, which is at most one scan old.
void act_row(int x)
{
  // only keys that differ from what was sent, or are locked out, need a look
  for (uint16_t work = (raw_down[x] ^ old_down[x]) | locked[x]; work; work &= work - 1) {
    int y = __builtin_ctz(work);
    uint16_t bit = 1 << y;
    if ((locked[x] & bit) && (scan_now - lock_start[x][y] < DEBOUNCE_US)) {
      // key is in its lockout window after a recent change; ignore it for now
    }
    else {
      locked[x] &= ~bit; // not locked out, so any change here is real - act now
      boolean pressed = (raw_down[x] & bit) != 0; // true = this change is a press, false = a release
      // the key changed state; a possible ghost press is skipped (not committed) and retried
      if ((pressed != ((old_down[x] & bit) != 0)) && (!pressed || press_ok(x, y))) {
// **********Modifier keys including the Fn special case
        if (modifier[x][y] != 0) {
          if (pressed) {
            if (modifier[x][y] != MODIFIERKEY_FN) { // Exclude Fn modifier key
              sent[x][y] = os_mod(modifier[x][y]); // the modifier this OS mode sends
              load_mod(sent[x][y]); // load the pressed modifier into its mod_... variable
              set_mod();           // load all modifier states into the report
            }
            else {
              Fn_pressed = LOW; // Fn status variable is active low
            }
          }
          else { // released
            if (modifier[x][y] != MODIFIERKEY_FN) {
              clear_mod(sent[x][y]); // clear what the press sent, even if OS mode changed
              sent[x][y] = 0;
              set_mod();            // load all modifier states into the report
            }
            else {
              Fn_pressed = HIGH; // Fn is no longer active
            }
          }
          commit_key(x, y, pressed);    // commit the new state, start the lockout window
        }
// ***********Consumer keys, shortcut keys, normal keys and media keys
        else if ((normal[x][y] != 0) || (media[x][y] != 0) || (consumer[x][y] != 0) ||
                 (shortcut[x][y] != 0) || (backlight_key[x][y] != 0)) {
          if (pressed) {
            boolean accepted = true;
            boolean use_media = (!Fn_pressed != fn_lock); // Fn held XOR Fn-lock
            if (!Fn_pressed && (normal[x][y] == KEY_ESC)) {
              fn_lock = !fn_lock; // Fn+Esc toggles Fn-lock; the Esc itself is not sent
              save_settings();
            }
            else if (!Fn_pressed && (normal[x][y] == KEY_P)) {
              set_os_mode(OS_WIN); // Fn+P = Windows; the P is not sent
            }
            else if (!Fn_pressed && (normal[x][y] == KEY_O)) {
              set_os_mode(OS_MAC); // Fn+O = Mac; the O is not sent
            }
            else if ((backlight_key[x][y] != 0) && (use_media || (normal[x][y] == 0))) {
              step_backlight(backlight_key[x][y]); // handled here, nothing sent to the host
            }
            else if ((consumer[x][y] != 0) && (use_media || (normal[x][y] == 0))) {
              // consumer key: sent unless Fn/Fn-lock picks the F-key, or always if there
              // is no F-key alternative.
              // Uses the media-key interface, so it does not need one of the 6 slots.
              Keyboard.press(consumer[x][y]);
              sent[x][y] = consumer[x][y];
            }
            else if ((shortcut[x][y] != 0) && (use_media || (normal[x][y] == 0))) {
              // shortcut key: same default/Fn rule as consumer keys, but it needs a free
              // slot for its key, so it retries like a normal key when the slots are full
              if (!slots_full) {
                sent[x][y] = press_shortcut(shortcut[x][y]);
                sent_sc[x][y] = true;
              }
              else {
                accepted = false;
              }
            }
            else if (!Fn_pressed && (media[x][y] != 0)) { // Fn pressed -> tap the media key
              if (media_tap) {
                Keyboard.release(media_tap); // end any tap still held
              }
              Keyboard.press(media[x][y]); // loop() sends the release after MEDIA_TAP_US
              media_tap = media[x][y];
              media_tap_start = micros();
            }
            else if ((normal[x][y] != 0) && !slots_full) { // normal key into a free slot
              load_slot(normal[x][y]);
              set_normals();
              sent[x][y] = normal[x][y];
            }
            else {
              // slots full: do not commit or lock out, so this press retries on the next
              // scan once one of the 6 slots frees up
              accepted = false;
            }
            if (accepted) {
              commit_key(x, y, pressed); // commit the press, start the lockout window
            }
          }
          else { // released - undo whatever the press sent
            if (sent_sc[x][y]) { // a shortcut: its key (if any) and its modifiers
              release_shortcut(sent[x][y]);
              sent_sc[x][y] = false;
            }
            else if (sent[x][y] == consumer[x][y] && sent[x][y] != 0) {
              Keyboard.release(sent[x][y]);
            }
            else if (sent[x][y] != 0) { // a normal key occupying a slot
              clear_slot(sent[x][y]);
              set_normals();
            }
            sent[x][y] = 0;
            commit_key(x, y, pressed); // commit the release, start the lockout window
          }
        }
        else {
          commit_key(x, y, pressed); // no key mapped at this cell; just track the state
        }
      }
    }
  }
}
//
// Function to scan the whole matrix. Each row is acted on as soon as it is read, and the
// next row is driven low first so it settles while that work is done: a row is still held
// low ROW_SETTLE_US before its columns are read, but the work no longer adds to the scan.
void scan_matrix()
{
  *row_clr[0] = row_mask[0]; // Activate the first row (send it low)
  uint32_t settle_start = ARM_DWT_CYCCNT;
  for (int x = 0; x < rows_max; x++) {
    settle_wait(settle_start);  // give the row time to go low and settle out
    uint32_t port_val[ports_max];
    read_ports(port_val);
    *row_set[x] = row_mask[x];  // De-activate Row (release it to hi-z)
    if (x + 1 < rows_max) {
      *row_clr[x + 1] = row_mask[x + 1]; // Activate the next row; it settles while this one is handled
      settle_start = ARM_DWT_CYCCNT;
    }
    decode_row(x, cols_down(port_val));
    act_row(x);
    flush_report(); // the row's changes go out at once, in one report
  }
//
  uint16_t busy = 0; // anything down, sent, or still inside a timed window?
  for (int x = 0; x < rows_max; x++) {
    busy |= raw_down[x] | old_down[x] | locked[x] | ghost_mask[x];
  }
#if LATENCY_DEBUG == 2
  busy = 1; // always do full scans, to time them
#endif
  matrix_idle = !busy;
}
//
// Function to check every key at once: all rows are driven low together and the columns
// read once. With no key held, any press pulls its column low, so one settle instead of
// rows_max tells whether a full scan is needed. Returns true if a column read low.
boolean any_key_down()
{
  for (int x = 0; x < rows_max; x++) {
    *row_clr[x] = row_mask[x];
  }
  uint32_t settle_start = ARM_DWT_CYCCNT;
  settle_wait(settle_start);
  uint32_t port_val[ports_max];
  read_ports(port_val);
  for (int x = 0; x < rows_max; x++) {
    *row_set[x] = row_mask[x];
  }
  for (int p = 0; p < port_count; p++) {
    if ((port_val[p] & port_cols[p]) != port_cols[p]) {
      return true; // a column on this port reads low
    }
  }
  return false;
}
//
extern volatile uint8_t keyboard_leds; // 8 bits sent from host to Teensy that give keyboard LED status. Caps lock is bit D1.
//
//---------------------------------Main Loop---------------------------------------------
//
void loop() {
// Scan keyboard matrix with an outer loop that drives each row low and an inner loop that reads every column (with pull ups).
// The routine compares each row's present state (raw_down, built from the column input pins) with the state last sent (old_down).
// The status of a key that was just pressed or just released is sent over USB and the state is saved in old_down.
// The keyboard keys read as logic low if they are pressed (negative logic); the row masks store pressed as 1.
//
#if LATENCY_DEBUG
  uint32_t dbg_now = ARM_DWT_CYCCNT;
  if (dbg_loop_start) { // time since the previous loop started (0 = just reported, skip)
    uint32_t loop_cycles = dbg_now - dbg_loop_start;
    dbg_loop_sum += loop_cycles;
    dbg_loops++;
    if (loop_cycles > dbg_loop_max) dbg_loop_max = loop_cycles;
  }
  dbg_loop_start = dbg_now;
#endif
  scan_now = micros();
  if (!matrix_idle || any_key_down()) { // idle and nothing down: skip the full scan
#if LATENCY_DEBUG
    uint32_t dbg_full_start = ARM_DWT_CYCCNT;
#endif
    scan_matrix();
#if LATENCY_DEBUG
    uint32_t full_cycles = ARM_DWT_CYCCNT - dbg_full_start;
    dbg_full_sum += full_cycles;
    if (full_cycles > dbg_full_max) dbg_full_max = full_cycles;
    dbg_full++;
#endif
  }
//
// **********keyboard scan complete
//
#if LATENCY_DEBUG
  uint32_t scan_cycles = ARM_DWT_CYCCNT - dbg_now;
  dbg_scan_sum += scan_cycles;
  if (scan_cycles > dbg_scan_max) dbg_scan_max = scan_cycles;
  dbg_scans++;
  if (millis() - dbg_report_at >= 1000) { // report once a second, then start a new window
    float cyc_per_us = F_CPU / 1000000.0f;
    Serial.printf("scans/s %lu | scan avg %.1f us max %.1f us | full/s %lu avg %.1f us max %.1f us | loop avg %.1f us max %.1f us | %.1f C\n",
                  dbg_scans,
                  dbg_scan_sum / (float)dbg_scans / cyc_per_us, dbg_scan_max / cyc_per_us,
                  dbg_full, dbg_full ? dbg_full_sum / (float)dbg_full / cyc_per_us : 0.0f,
                  dbg_full_max / cyc_per_us,
                  dbg_loop_sum / (float)dbg_loops / cyc_per_us, dbg_loop_max / cyc_per_us,
                  tempmonGetTemp()); // chip temperature
    dbg_scan_max = dbg_loop_max = dbg_scans = dbg_loops = dbg_full = dbg_full_max = 0;
    dbg_scan_sum = dbg_loop_sum = dbg_full_sum = 0;
    dbg_loop_start = 0; // the loop that printed is not counted
    dbg_report_at = millis();
  }
#endif
//
// Turn on the LED on the Teensy for Caps Lock based on bit 1 in the keyboard_leds variable controlled by the USB host computer
//
  if (keyboard_leds & 1<<1) {  // mask off all bits but D1 and test if set
    digitalWriteFast(CAPS_LED, HIGH); // turn on the LED
  }
  else {
    digitalWriteFast(CAPS_LED, LOW); // turn off the LED
  }
  set_ind(IND_CAPS, keyboard_leds & 1<<1); // same state on the Caps Lock key LED
  set_ind(IND_COMP3, fn_lock);             // computer 3 key LED shows Fn-lock
//
  if ((bl_now != bl_duty[bl_level]) && (micros() - bl_ramp_at >= BL_RAMP_US)) { // fade toward its level
    bl_ramp_at = micros();
    int target = bl_duty[bl_level];
    if (bl_now < target) {
      bl_now = min(bl_now + BL_RAMP_STEP, target);
    }
    else {
      bl_now = max(bl_now - BL_RAMP_STEP, target);
    }
    analogWrite(BACKLIGHT_PIN, bl_now);
  }
//
  if (flash_pin && (millis() - flash_start >= FLASH_MS)) { // end a confirmation flash
    set_ind(flash_pin, false);
    flash_pin = 0;
  }
//
  if (media_tap && (micros() - media_tap_start >= MEDIA_TAP_US)) { // end a Fn+media tap
    Keyboard.release(media_tap);
    media_tap = 0;
  }
//
// No delay here: the next scan starts right away. An idle check (one ROW_SETTLE_US) or a full scan (rows_max * ROW_SETTLE_US plus
// the reads) takes at most tens of microseconds at 150 MHz, well under the 125us USB poll interval at
// 8000Hz, and debounce is timed per key, so scanning this fast causes no chatter.
}
